/*
 * Copyright (c) 2026 Alif Semiconductor.
 * SPDX-License-Identifier: Apache-2.0
 */

ns: &ns {
	status = "okay";
};

/* GPIO14 is needed for SDHC reset */
&gpio14 {
	status = "okay";
};

sdhc: &sdhc {
	status = "okay";
	/* eMMC is always present — no card-detect GPIO needed */
	/delete-property/ cd-gpios;
	bus-width = <8>;

	mmc {
		compatible = "zephyr,mmc-disk";
		disk-name = "SD2";
		bus-width = <8>;
		status = "okay";
	};
};
