/*
 * Copyright (c) 2026 Alif Semiconductor.
 * SPDX-License-Identifier: Apache-2.0
 *
 * Combined 8-bit eMMC snippet for DevKit-E8. Includes the 4-bit alif-emmc
 * overlay, then muxes DAT[7:4] and sets host+card bus-width to 8.
 * 25 MHz / 3.3 V. pad 0x29.
 * Pass -S alif-emmc-8bit only (do not also pass -S alif-emmc).
 */

#include "../alif-emmc/alif_ensemble_e8_dk.overlay"

&pinctrl_sdmmc {
	/* D4-D7: pull-up, 4 mA, slow slew, no Schmitt (pad 0x29). */
	group1 {
		pinmux = < PIN_P8_4__SD_D4_C >,
			 < PIN_P8_5__SD_D5_C >,
			 < PIN_P8_6__SD_D6_C >,
			 < PIN_P8_7__SD_D7_C >;
		read-enable = <0x1>;
		schmitt-enable = <0x0>;
		slew-rate = <0>;
		driver-state-control = <1>;
		drive-strength = <4>;
	};
};

&sdhc {
	bus-width = <8>;
	no-1-8-v;
	max-bus-freq = <25000000>;

	mmc {
		bus-width = <8>;
	};
};
